## app/boards/my_board/Kconfig.my_board
```kconfig
config BOARD_MY_BOARD
	select SOC_NRF5340_CPUAPP_QKAA if BOARD_MY_BOARD_NRF5340_CPUAPP
```

## app/boards/my_board/board.yml
```yaml
board:
  name: my_board
  full_name: My Board From Scratch
  vendor: albano
  socs:
  - name: 'nrf5340'
    variants:
    - name: 'ns'
      cpucluster: 'cpuapp'
```

## app/boards/our_board/board.yml
```yaml
board:
  name: our_board
  full_name: Our Board
  vendor: albano
  socs:
  - name: 'nrf5340'
    variants:
    - name: 'ns'
      cpucluster: 'cpuapp'
```

## twister-out/native_sim_native/host_gnu/zephyr-course/tests/ring_buf/homework.unit.ring_buf/Kconfig/arch/Kconfig.tmp
```kconfig
# Load Zephyr Arch Kconfig descriptions.
osource "/home/penia/zephyr_workspace/deps/zephyr/arch/rx/Kconfig"
osource "/home/penia/zephyr_workspace/deps/zephyr/arch/x86/Kconfig"
osource "/home/penia/zephyr_workspace/deps/zephyr/arch/xtensa/Kconfig"
osource "/home/penia/zephyr_workspace/deps/zephyr/arch/sparc/Kconfig"
osource "/home/penia/zephyr_workspace/deps/zephyr/arch/riscv/Kconfig"
osource "/home/penia/zephyr_workspace/deps/zephyr/arch/posix/Kconfig"
osource "/home/penia/zephyr_workspace/deps/zephyr/arch/openrisc/Kconfig"
osource "/home/penia/zephyr_workspace/deps/zephyr/arch/mips/Kconfig"
osource "/home/penia/zephyr_workspace/deps/zephyr/arch/arm64/Kconfig"
osource "/home/penia/zephyr_workspace/deps/zephyr/arch/arm/Kconfig"
osource "/home/penia/zephyr_workspace/deps/zephyr/arch/arc/Kconfig"
```

## twister-out/native_sim_native/host_gnu/zephyr-course/tests/ring_buf/homework.unit.ring_buf/Kconfig/boards/Kconfig.defconfig.tmp
```kconfig
# Load Zephyr board defconfig descriptions.
osource "/home/penia/zephyr_workspace/deps/zephyr/boards/native/native_sim/Kconfig.defconfig"
```

## twister-out/native_sim_native/host_gnu/zephyr-course/tests/ring_buf/homework.unit.ring_buf/Kconfig/boards/Kconfig.native_sim.tmp
```kconfig
# Load board Kconfig descriptions.
osource "/home/penia/zephyr_workspace/deps/zephyr/boards/native/native_sim/Kconfig.native_sim"
```

## twister-out/native_sim_native/host_gnu/zephyr-course/tests/ring_buf/homework.unit.ring_buf/Kconfig/boards/Kconfig.sysbuild.tmp
```kconfig
# Load Sysbuild board Kconfig descriptions.
osource "/home/penia/zephyr_workspace/deps/zephyr/boards/native/native_sim/Kconfig.sysbuild"
```
